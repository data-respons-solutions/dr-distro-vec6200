## meta-vec6200/conf/layer.conf
```bitbake
# We have a conf and classes directory, add to BBPATH
BBPATH .= ":${LAYERDIR}"

# We have a packages directory, add to BBFILES
BBFILES += "${LAYERDIR}/recipes-*/*/*.bb \
            ${LAYERDIR}/recipes-*/*/*.bbappend"

BBFILE_COLLECTIONS += "vec6200-layer"
BBFILE_PATTERN_vec6200-layer := "^${LAYERDIR}/"
BBFILE_PRIORITY_vec6200-layer = "6"

LAYERDEPENDS_vec6200-layer = "core freescale-layer bsp-common-layer bsp-vec6200-layer"
LAYERSERIES_COMPAT_vec6200-layer = "zeus"

# Let us add layer-specific bbappends which are only applied when that
# layer is included in our configuration
BBFILES += "${@' '.join('${LAYERDIR}/%s/recipes*/*/*.bbappend' % layer \
               for layer in BBFILE_COLLECTIONS.split())}"
               
```
